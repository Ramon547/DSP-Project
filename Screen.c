/*
 * Screen.c
 *
 *  Created on: May 7, 2025
 *      Author: ramon
 */


#include <SCREEN.h>
#include <stdint.h>
#include "stm32h7xx_hal.h"

// Global I2C handle

// 5x7 font for 'A' to 'Z'
static const uint8_t font5x7[][5] = {
		// ' ' (32)
		  {0x00, 0x00, 0x00, 0x00, 0x00},
		  // '!' (33)
		  {0x00, 0x00, 0x5F, 0x00, 0x00},
		  // '"' (34)
		  {0x00, 0x07, 0x00, 0x07, 0x00},
		  // '#' (35)
		  {0x14, 0x7F, 0x14, 0x7F, 0x14},
		  // '$' (36)
		  {0x24, 0x2A, 0x7F, 0x2A, 0x12},
		  // '%' (37)
		  {0x23, 0x13, 0x08, 0x64, 0x62},
		  // '&' (38)
		  {0x36, 0x49, 0x55, 0x22, 0x50},
		  // ''' (39)
		  {0x00, 0x05, 0x03, 0x00, 0x00},
		  // '(' (40)
		  {0x1C, 0x22, 0x41, 0x00, 0x00},
		  // ')' (41)
		  {0x00, 0x41, 0x22, 0x1C, 0x00},
		  // '*' (42)
		  {0x14, 0x08, 0x3E, 0x08, 0x14},
		  // '+' (43)
		  {0x08, 0x08, 0x3E, 0x08, 0x08},
		  // ',' (44)
		  {0x00, 0x50, 0x30, 0x00, 0x00},
		  // '-' (45)
		  {0x08, 0x08, 0x08, 0x08, 0x08},
		  // '.' (46)
		  {0x00, 0x60, 0x60, 0x00, 0x00},
		  // '/' (47)
		  {0x20, 0x10, 0x08, 0x04, 0x02},
		  // '0' (48)
		  {0x3E, 0x51, 0x49, 0x45, 0x3E},
		  // '1' (49)
		  {0x00, 0x42, 0x7F, 0x40, 0x00},
		  // '2' (50)
		  {0x42, 0x61, 0x51, 0x49, 0x46},
		  // '3' (51)
		  {0x21, 0x41, 0x45, 0x4B, 0x31},
		  // '4' (52)
		  {0x18, 0x14, 0x12, 0x7F, 0x10},
		  // '5' (53)
		  {0x27, 0x45, 0x45, 0x45, 0x39},
		  // '6' (54)
		  {0x3C, 0x4A, 0x49, 0x49, 0x30},
		  // '7' (55)
		  {0x01, 0x71, 0x09, 0x05, 0x03},
		  // '8' (56)
		  {0x36, 0x49, 0x49, 0x49, 0x36},
		  // '9' (57)
		  {0x06, 0x49, 0x49, 0x29, 0x1E},
		  // ':' (58)
		  {0x00, 0x36, 0x36, 0x00, 0x00},
		  // ';' (59)
		  {0x00, 0x56, 0x36, 0x00, 0x00},
		  // '<' (60)
		  {0x08, 0x14, 0x22, 0x41, 0x00},
		  // '=' (61)
		  {0x14, 0x14, 0x14, 0x14, 0x14},
		  // '>' (62)
		  {0x00, 0x41, 0x22, 0x14, 0x08},
		  // '?' (63)
		  {0x02, 0x01, 0x51, 0x09, 0x06},
		  // '@' (64)
		  {0x32, 0x49, 0x79, 0x41, 0x3E},
		  // 'A' (65)
		  {0x7E, 0x11, 0x11, 0x11, 0x7E},
		  // 'B' (66)
		  {0x7F, 0x49, 0x49, 0x49, 0x36},
		  // 'C' (67)
		  {0x3E, 0x41, 0x41, 0x41, 0x22},
		  // 'D' (68)
		  {0x7F, 0x41, 0x41, 0x22, 0x1C},
		  // 'E' (69)
		  {0x7F, 0x49, 0x49, 0x49, 0x41},
		  // 'F' (70)
		  {0x7F, 0x09, 0x09, 0x09, 0x01},
		  // 'G' (71)
		  {0x3E, 0x41, 0x49, 0x49, 0x7A},
		  // 'H' (72)
		  {0x7F, 0x08, 0x08, 0x08, 0x7F},
		  // 'I' (73)
		  {0x00, 0x41, 0x7F, 0x41, 0x00},
		  // 'J' (74)
		  {0x20, 0x40, 0x41, 0x3F, 0x01},
		  // 'K' (75)
		  {0x7F, 0x08, 0x14, 0x22, 0x41},
		  // 'L' (76)
		  {0x7F, 0x40, 0x40, 0x40, 0x40},
		  // 'M' (77)
		  {0x7F, 0x02, 0x0C, 0x02, 0x7F},
		  // 'N' (78)
		  {0x7F, 0x04, 0x08, 0x10, 0x7F},
		  // 'O' (79)
		  {0x3E, 0x41, 0x41, 0x41, 0x3E},
		  // 'P' (80)
		  {0x7F, 0x09, 0x09, 0x09, 0x06},
		  // 'Q' (81)
		  {0x3E, 0x41, 0x51, 0x21, 0x5E},
		  // 'R' (82)
		  {0x7F, 0x09, 0x19, 0x29, 0x46},
		  // 'S' (83)
		  {0x46, 0x49, 0x49, 0x49, 0x31},
		  // 'T' (84)
		  {0x01, 0x01, 0x7F, 0x01, 0x01},
		  // 'U' (85)
		  {0x3F, 0x40, 0x40, 0x40, 0x3F},
		  // 'V' (86)
		  {0x1F, 0x20, 0x40, 0x20, 0x1F},
		  // 'W' (87)
		  {0x3F, 0x40, 0x38, 0x40, 0x3F},
		  // 'X' (88)
		  {0x63, 0x14, 0x08, 0x14, 0x63},
		  // 'Y' (89)
		  {0x07, 0x08, 0x70, 0x08, 0x07},
		  // 'Z' (90)
		  {0x61, 0x51, 0x49, 0x45, 0x43},
		  // '[' (91)
		  {0x00, 0x7F, 0x41, 0x41, 0x00},
		  // '\' (92)
		  {0x02, 0x04, 0x08, 0x10, 0x20},
		  // ']' (93)
		  {0x00, 0x41, 0x41, 0x7F, 0x00},
		  // '^' (94)
		  {0x04, 0x02, 0x01, 0x02, 0x04},
		  // '_' (95)
		  {0x40, 0x40, 0x40, 0x40, 0x40},

};

void SCREEN_WriteCommand(uint8_t cmd, I2C_HandleTypeDef *oled_i2c) {
    uint8_t control = 0x00;
    HAL_I2C_Mem_Write(oled_i2c, SCREEN_I2C_ADDR, control, I2C_MEMADD_SIZE_8BIT, &cmd, 1, HAL_MAX_DELAY);
}

void SCREEN_WriteData(uint8_t *data, size_t size, I2C_HandleTypeDef *oled_i2c) {
    uint8_t control = 0x06;
    HAL_I2C_Mem_Write(oled_i2c, SCREEN_I2C_ADDR, control, I2C_MEMADD_SIZE_8BIT, data, size, HAL_MAX_DELAY);
}

void SCREEN_Init(I2C_HandleTypeDef *oled_i2c) {
/*
    HAL_Delay(100);
    SCREEN_WriteCommand(0xAE, oled_i2c); // Display off
    SCREEN_WriteCommand(0xA1, oled_i2c); // Segment remap
    SCREEN_WriteCommand(0xDA, oled_i2c); SCREEN_WriteCommand(0x12, oled_i2c); // COM pins
    SCREEN_WriteCommand(0xC8, oled_i2c); // COM scan dir
    SCREEN_WriteCommand(0x81, oled_i2c); SCREEN_WriteCommand(0x7F, oled_i2c); // Contrast
    SCREEN_WriteCommand(0xA4, oled_i2c); // Display RAM content
    SCREEN_WriteCommand(0xA6, oled_i2c); // Normal display
    SCREEN_WriteCommand(0xAF, oled_i2c); // Display ON
*/
    HAL_Delay(100);

    SCREEN_WriteCommand(0xAF, oled_i2c); // Display on
    SCREEN_WriteCommand(0xA5, oled_i2c);
    SCREEN_WriteCommand(0xA6, oled_i2c);
    SCREEN_WriteCommand(0xDC, oled_i2c); SCREEN_WriteCommand(0x01, oled_i2c); // Display start line = 0
    SCREEN_WriteCommand(0x81, oled_i2c); SCREEN_WriteCommand(0x2F, oled_i2c); // Contrast
    SCREEN_WriteCommand(0x20, oled_i2c); // Set memory mode: Page Addressing
    SCREEN_WriteCommand(0xA0, oled_i2c); // Segment remap (normal)
    SCREEN_WriteCommand(0xC0, oled_i2c); // COM scan direction (normal)
    SCREEN_WriteCommand(0xA8, oled_i2c); SCREEN_WriteCommand(0x7F, oled_i2c); // Multiplex ratio
}

void SCREEN_SetCursor(uint8_t col, uint8_t page, I2C_HandleTypeDef *oled_i2c) {
    SCREEN_WriteCommand(0xB0 + page, oled_i2c);              // Set page
    SCREEN_WriteCommand(0x10 | (col >> 4), oled_i2c);        // Set high column
    SCREEN_WriteCommand(0x00 | (col & 0x0F), oled_i2c);      // Set low column

}

void SCREEN_WriteChar(char c, I2C_HandleTypeDef *oled_i2c, uint8_t col, uint8_t page) {
	HAL_Delay(10);
//    uint8_t index = c - 'A';
//    SCREEN_SetCursor(col,page, oled_i2c);
//    SCREEN_WriteData((uint8_t*)font5x7[index], 5, oled_i2c);
	if (c >= ' ') {
	        if (c <= '_') {
	            uint8_t index = c - ' ';
	            SCREEN_SetCursor(col, page, oled_i2c);
	            SCREEN_WriteData((uint8_t*)font5x7[index], 5, oled_i2c);
	        }
	    }
}

void SCREEN_Clear(I2C_HandleTypeDef *oled_i2c) {
    for (uint8_t page = 0; page < 8; page++) {
        SCREEN_SetCursor(0, page, oled_i2c);
        for (uint8_t i = 0; i < 128; i++) {
            uint8_t zero = 0x00;
            SCREEN_WriteData(&zero, 1, oled_i2c);
        }
    }
}

void SCREEN_WriteString(const char *str, I2C_HandleTypeDef *oled_i2c, uint8_t col, uint8_t page) {
    while (*str) {
        SCREEN_WriteChar(*str, oled_i2c, col, page);
        col += 6;  // 5 pixels per character + 1 pixel spacing
        str++;
    }
}

